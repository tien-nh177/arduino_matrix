/* Указываем входы платы соответствующие строка матрицы по порядку.
Первая строка соответствует 24 пину LED-матрицы - он подключен к 13 выходу платы
Вторая строка соответствует 23 пину LED-матрицы - он подключен к 12 выходу платы
...
За пятую строку отвечает 4 пин LED-матрицы - он подключен к выходу A3 и т.д.
*/
int rowPins[] = {13, 12, 11, 10, A3, A2, A1, A0}; 


/* Указываем входы платы соответствующие столбцам матрицы по порядку
Первый столбец соответствует 20 пину LED-матрицы - он подключен к 9 выходу платы
Второй столбец соответствует 19 пину LED-матрицы - он подключен к 8 выходу платы
...
*/
int colPins[] = {9, 8, 7, 6, 5, 4, 3, 2};    

int mask[8][8] = {
  {0, 0, 1, 1, 1, 1, 0, 0},
  {0, 1, 0, 0, 0, 0, 1, 0},
  {1, 0, 1, 0, 0, 1, 0, 1},
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  {0, 0, 1, 1, 1, 1, 0, 0}
};

void setup()
{
  for (int i = 0; i < 8; ++i) {
    pinMode(rowPins[i], OUTPUT); // Определяем пины как выход
    pinMode(colPins[i], OUTPUT); // Определяем пины как выход
  }
}

void loop()
{
  for (int r = 0; r < 8; ++r) {
    for (int c = 0; c < 8; ++c) {
      /*Сначала присваиваем значения столбцам, чтобы при подключении напряжения к
      аноду загорелась сразу вся строка - если подавать сначала напряжение на анод,
      диоды будут разной яркости*/
      digitalWrite(colPins[c], ((mask[r][c] == 1) ? LOW : HIGH));
    }
    digitalWrite(rowPins[r], HIGH); /*Подаем напряжение на анод - зажигаем всю строку*/
    /*Если значение паузы изменить до видимого значения 100, то станет понятен механизм работы*/
    delay(100); /*Делаем паузу, чтобы зафиксировать изображение*/
    digitalWrite(rowPins[r], LOW); /*Убираем напряжение со строки, переходим к следующей*/
  }
}
